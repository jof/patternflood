// ===== Patternflow pattern =====
// Title:    seacoast
// Author:   @engmung
// Source:   https://community.patternflow.work/community/p/169a7c52727f4531
// SPDX-License-Identifier: CC-BY-SA-4.0
// ===============================
// Adapted for Patternflood's 128 x 128 panel (2026-10-30): the same beach, twice the size.
// The sand is the original's 64 x 128 drawing, its lower half (rows 64..127: the scallop
// and the two pebbles) drawn at 2 x, pixel for pixel, so it fills the square; the water is
// the original's code layer, unchanged, over the whole square (its columns grow with it, as
// chunky as the sand's pixels, and the shore keeps its 30 degree slant). Grown as written,
// the 64-wide drawing was laid into a 128-wide buffer and filled only the top half.
// Pattern: seacoast — Pattern Lab layer-stack composition (2 layers)
//
// SCAFFOLD (deterministic, generated by Pattern Lab — do not hand-edit):
// buffers, shared-knob accumulation, ramp LUTs, pixel art, masks, blending
// and compositing are finished code. ONLY the "namespace L<i>" blocks between
// the >>> markers are translated from each layer's JavaScript; stubs compile
// to a black layer until replaced.
//
// Layers (bottom → top):
//   L0. Pixel 1 (pixel, normal, 100%)
//   L1. Code 1 (code, normal, 100%)
#pragma once
#include <Arduino.h>
#include "config.h"
#include "src/core_display.h"
#include "src/core_encoders.h"
#include "src/core_canvas.h"
#include "src/core_mem.h"
#include "src/core_math.h"
#include "src/core_color.h"
#include "src/core_noise.h"

namespace LabStack_seacoast {

const char* NAME = "seacoast";
const char* const KNOB_LABELS[4] = {"Speed", "Height", "Bands", "PixelScale"};

constexpr int FRAME_W = 128;
constexpr int FRAME_H = 128;
constexpr int PIX_N = FRAME_W * FRAME_H;
constexpr int ART_W = 64, ART_H = 128;   // the drawing as Pattern Lab baked it
constexpr int ART_TOP = 64;            // its first row in the square, which shows 64 x 64 of it at 2 x
constexpr int LAYER_N = 2;

// ── Shared knobs: encoder detents become values HERE, once, for every layer ──
static const float KNOB_MIN[4]  = {0.2f, 0.2f, 2.0f, 8.0f};
static const float KNOB_MAX[4]  = {3.0f, 0.95f, 12.0f, 32.0f};
static const float KNOB_STEP[4] = {0.05f, 0.1f, 0.05f, 0.05f}; // value per detent (calibrated)
static float knobVal[4]  = {1.521f, 0.444f, 4.614f, 27.447f};
static float knobNorm[4] = {0.47179f, 0.32533f, 0.2614f, 0.81029f};

// ── Layer buffers (RGBA8, PSRAM-first, allocated once in setup) ──
static uint8_t* layerBuf[LAYER_N] = {nullptr, nullptr};

// ── Composite plan (bottom → top; blend: 0 normal, 1 add, 2 multiply, 3 screen) ──
constexpr int GROUP_N = 2;
static const uint8_t G_LAYER[2]   = {0, 1};
static const float   G_OPACITY[2] = {1.0f, 1.0f};
static const uint8_t G_BLEND[2]   = {0, 0};
static const uint8_t G_MASK_AT[2] = {0, 0};
static const uint8_t G_MASK_N[2]  = {0, 0};
static const uint8_t MASK_LAYER[1]  = {0};
static const uint8_t MASK_PXART[1]  = {0};
static const uint8_t MASK_INVERT[1] = {0};

// ── L0 "Pixel 1": pixel art, RLE {count,r,g,b,a} — decoded once in setup ──
static const uint8_t L0_RLE[36080] = {
  64,0,0,0,0,1,184,118,66,255,1,185,118,66,255,1,186,119,67,255,
  1,184,118,66,255,1,185,119,69,255,1,185,119,67,255,1,186,118,69,255,
  1,185,117,68,255,2,185,119,67,255,1,182,119,68,255,1,184,116,67,255,
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  1,72,34,45,255,1,168,120,82,255,1,171,121,84,255,1,121,75,59,255
};

// ── L1 "Code 1": ramp LUT (RGBA, alpha included — baked by Pattern Lab, copy-proof) ──
static const uint8_t L1_RAMP[256][4] = {
  {0,0,0,0},{48,48,48,48},{95,95,95,95},{143,143,143,143},{190,190,190,190},{238,238,238,238},{250,253,255,255},{242,249,255,255},
  {235,246,255,255},{227,243,254,255},{220,239,254,255},{212,236,254,255},{205,233,254,255},{197,229,254,255},{190,226,254,255},{182,223,254,255},
  {174,219,253,255},{167,216,253,255},{159,213,253,255},{152,209,253,255},{144,206,253,255},{137,203,253,255},{130,199,253,255},{122,196,252,255},
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  {199,224,255,255},{199,224,255,255},{199,224,255,255},{199,224,255,255},{199,224,255,255},{199,224,255,255},{199,224,255,255},{199,224,255,255}
};
static inline void L1_setValue(int x, int y, float v) {
  if ((unsigned)x >= (unsigned)FRAME_W || (unsigned)y >= (unsigned)FRAME_H) return;
  if (!(v > 0.0f)) v = 0.0f; else if (v > 1.0f) v = 1.0f;
  const uint8_t* c = L1_RAMP[(int)(v * 255.0f + 0.5f)];
  uint8_t* p = layerBuf[1] + (((size_t)y * FRAME_W + x) << 2);
  p[0] = c[0]; p[1] = c[1]; p[2] = c[2]; p[3] = c[3];
}
static inline void L1_setPixel(int x, int y, uint8_t r, uint8_t g, uint8_t b) {
  if ((unsigned)x >= (unsigned)FRAME_W || (unsigned)y >= (unsigned)FRAME_H) return;
  uint8_t* p = layerBuf[1] + (((size_t)y * FRAME_W + x) << 2);
  p[0] = r; p[1] = g; p[2] = b; p[3] = 255;
}

// >>> LAYER 1 TRANSLATION BEGIN <<<
namespace L1 {
  static float t = 0.0f;
  static float smoothHeight = 0.324f;

  void setup() {
    PFMath::buildSinLUT();
    t = 0.0f;
    smoothHeight = 0.324f;
  }

  void update(float dt, const InputFrame& input) {
    (void)input;
    float speed = knobVal[0];
    t += dt * speed;
    if (t >= TWO_PI * 20.0f) {
      t -= TWO_PI * 20.0f;
    }

    // 원래 범위(0.2 ~ 0.95)는 100% 보존하면서, 
    // 급격한 변화 없이 미세하고 연속적으로 조절되도록 댐핑(EMA) 필터 적용
    float targetHeight = knobVal[1];
    if (targetHeight < 0.2f) targetHeight = 0.2f;
    if (targetHeight > 0.95f) targetHeight = 0.95f;

    smoothHeight += (targetHeight - smoothHeight) * (1.0f - expf(-3.5f * dt));
  }

  void draw() {
    const float height = smoothHeight;

    int bands = (int)knobVal[2];
    if (bands < 2) bands = 2;

    float pixelScale = floorf(knobVal[3]);
    if (pixelScale < 4.0f) pixelScale = 4.0f;

    const float minV = 0.18f;
    const float foamWidth = 0.12f;

    const float aspectTilt = 0.577350269f * ((float)FRAME_W / (float)FRAME_H);

    const float invW = 1.0f / (float)FRAME_W;
    const float invH = 1.0f / (float)FRAME_H;
    const float invBands1 = 1.0f / (float)(bands - 1);
    const float t2Step = floorf(t * 2.0f) * 0.2f;
    const float t35 = t * 3.5f;

    for (int y = 0; y < FRAME_H; y++) {
      float ny = (float)y * invH;

      for (int x = 0; x < FRAME_W; x++) {
        float nx = (float)x * invW;

        float pixelX = floorf(nx * pixelScale) / pixelScale;

        float shoreTilt = -aspectTilt * (pixelX - 0.5f);

        float shoreY = 0.08f + height * 0.82f +
                       PFMath::fastSin(pixelX * PI * 3.0f + t2Step) * 0.04f +
                       shoreTilt;

        if (ny > shoreY) {
          L1_setValue(x, y, 0.0f);
          continue;
        }

        float depthRatio = ny / shoreY;

        float wavePattern = PFMath::fastSin(
          depthRatio * 12.0f - t35 + PFMath::fastSin(pixelX * 8.0f)
        );

        float rawV = minV + depthRatio * 0.45f + wavePattern * 0.12f;
        if (rawV < minV) rawV = minV;
        if (rawV > 0.85f) rawV = 0.85f;

        float normalized = (rawV - minV) / (0.85f - minV);
        float qStep = floorf(normalized * (float)bands) * invBands1;
        float v = minV + qStep * 0.67f;

        if (fabsf(wavePattern - 0.75f) < foamWidth) {
          v = 1.0f;
        }

        if (ny > shoreY - 0.02f) {
          float fade = (shoreY - ny) / 0.02f;
          float clampFade = (fade < 0.0f) ? 0.0f : fade;
          v *= clampFade;
        }

        if (v < 0.0f) v = 0.0f;
        if (v > 1.0f) v = 1.0f;

        L1_setValue(x, y, v);
      }
    }
  }
}
// >>> LAYER 1 TRANSLATION END <<<

// ── Deterministic pipeline (do not edit) ──
static void rleDecode(const uint8_t* rle, size_t len, uint8_t* out, size_t cap) {
  size_t o = 0;
  for (size_t i = 0; i + 4 < len && o < cap; i += 5) {
    for (int k = 0; k < rle[i] && o < cap; k++) {
      out[o++] = rle[i + 1]; out[o++] = rle[i + 2]; out[o++] = rle[i + 3]; out[o++] = rle[i + 4];
    }
  }
}

// Binary mask test — identical to the Pattern Lab preview: pixel art is "on"
// where something was drawn (alpha >= 0.5); code layers where ramp-colored
// luminance x alpha crosses 0.5.
static inline bool maskOn(const uint8_t* p, bool pixelArt, bool invert) {
  bool on;
  if (pixelArt) on = p[3] >= 128;
  else on = (0.2126f * p[0] + 0.7152f * p[1] + 0.0722f * p[2]) * (p[3] / 255.0f) >= 127.5f;
  return invert ? !on : on;
}

static void recolorBuffer(uint8_t* buf, const uint8_t lut[256][4]) {
  for (int i = 0; i < PIX_N; i++) {
    uint8_t* p = buf + (size_t)i * 4;
    if (p[3] == 0) continue;
    int lum = (int)(0.2126f * p[0] + 0.7152f * p[1] + 0.0722f * p[2] + 0.5f);
    if (lum > 255) lum = 255;
    const uint8_t* c = lut[lum];
    p[0] = c[0]; p[1] = c[1]; p[2] = c[2]; p[3] = c[3];
  }
}

void setup() {
  for (int i = 0; i < LAYER_N; i++)
    if (!layerBuf[i]) layerBuf[i] = (uint8_t*)PFMem::alloc((size_t)PIX_N * 4);
  for (int i = 0; i < LAYER_N; i++)
    if (!layerBuf[i]) return; // allocation failed → draw() degrades to blank
  // The drawing at its own size, then its lower half at 2 x into the layer.
  uint8_t* art = (uint8_t*)PFMem::alloc((size_t)ART_W * ART_H * 4);
  memset(layerBuf[0], 0, (size_t)PIX_N * 4);
  if (art) {
    rleDecode(L0_RLE, sizeof(L0_RLE), art, (size_t)ART_W * ART_H * 4);
    for (int y = 0; y < FRAME_H; y++)
      for (int x = 0; x < FRAME_W; x++)
        memcpy(layerBuf[0] + (((size_t)y * FRAME_W + x) << 2),
               art + (((size_t)(ART_TOP + y / 2) * ART_W + x / 2) << 2), 4);
    free(art);
  }
  L1::setup();
}

void update(float dt, const InputFrame& input) {
  for (int i = 0; i < 4; i++) {
    knobVal[i] += input.knobDeltas[i] * KNOB_STEP[i];
    if (knobVal[i] < KNOB_MIN[i]) knobVal[i] = KNOB_MIN[i];
    if (knobVal[i] > KNOB_MAX[i]) knobVal[i] = KNOB_MAX[i];
    knobNorm[i] = (knobVal[i] - KNOB_MIN[i]) / (KNOB_MAX[i] - KNOB_MIN[i]);
  }
  L1::update(dt, input);
}

void draw() {
  PFCanvas::setFrame(FRAME_W, FRAME_H);
  for (int i = 0; i < LAYER_N; i++)
    if (!layerBuf[i]) { PFCanvas::present(); return; }

  memset(layerBuf[1], 0, (size_t)PIX_N * 4);
  L1::draw();

  // Composite bottom → top over the panel's black — same math as the web preview.
  for (int y = 0; y < FRAME_H; y++) {
    for (int x = 0; x < FRAME_W; x++) {
      const size_t j = ((size_t)y * FRAME_W + x) << 2;
      float cr = 0.0f, cg = 0.0f, cb = 0.0f;
      for (int gi = 0; gi < GROUP_N; gi++) {
        bool hidden = false;
        for (int m = 0; m < G_MASK_N[gi]; m++) {
          const int mi = G_MASK_AT[gi] + m;
          if (!maskOn(layerBuf[MASK_LAYER[mi]] + j, MASK_PXART[mi] != 0, MASK_INVERT[mi] != 0)) {
            hidden = true;
            break;
          }
        }
        if (hidden) continue;
        const uint8_t* p = layerBuf[G_LAYER[gi]] + j;
        const float a = (p[3] / 255.0f) * G_OPACITY[gi];
        if (a <= 0.0f) continue;
        const float sr = p[0], sg = p[1], sb = p[2], inv = 1.0f - a;
        switch (G_BLEND[gi]) {
          case 1: cr += sr * a; cg += sg * a; cb += sb * a; break;
          case 2:
            cr = cr * inv + (cr * sr / 255.0f) * a;
            cg = cg * inv + (cg * sg / 255.0f) * a;
            cb = cb * inv + (cb * sb / 255.0f) * a;
            break;
          case 3:
            cr = cr * inv + (255.0f - (255.0f - cr) * (255.0f - sr) / 255.0f) * a;
            cg = cg * inv + (255.0f - (255.0f - cg) * (255.0f - sg) / 255.0f) * a;
            cb = cb * inv + (255.0f - (255.0f - cb) * (255.0f - sb) / 255.0f) * a;
            break;
          default:
            cr = cr * inv + sr * a;
            cg = cg * inv + sg * a;
            cb = cb * inv + sb * a;
            break;
        }
      }
      int ir = (int)(cr + 0.5f); if (ir > 255) ir = 255;
      int ig = (int)(cg + 0.5f); if (ig > 255) ig = 255;
      int ib = (int)(cb + 0.5f); if (ib > 255) ib = 255;
      PFCanvas::setPixel(x, y, (uint8_t)ir, (uint8_t)ig, (uint8_t)ib);
    }
  }
  PFCanvas::present();
}

} // namespace LabStack_seacoast