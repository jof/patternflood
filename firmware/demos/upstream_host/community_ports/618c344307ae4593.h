// ===== Patternflow pattern =====
// Title:    Elephant Walk
// Author:   Stasik / NASHE MESTO
// Source:   https://community.patternflow.work/community/p/618c344307ae4593
// SPDX-License-Identifier: CC-BY-SA-4.0
// ===============================
// Adapted for Patternflood's 128 x 128 panel (2026-10-28): the published 128 x 64 frame
// lies on its side, so the 13 hand-drawn walk-cycle frames are drawn turned a quarter
// anticlockwise (the old right edge is the top): the elephant stands upright, head and
// ears up, 128 px tall, centred in the square. The breathing rings now come in from the
// whole square: the scaled-silhouette field (how many silhouette radii a pixel sits out
// from frame 0's centroid, along the ray through it, the same rule the original baked
// into OWN_SCALE) is computed at setup for the turned 128 x 128 frame, so the corners,
// up to ~3.7 radii out, sit on rings too. Past 1.6 radii the outline eases into a copy
// of itself smoothed over a few degrees, so its one-pixel notches don't fan out into
// sawteeth by the corners. Nine rings 0.35 apart instead of four, so the spacing,
// closing speed and inhale/exhale timing at any spot are the original's. Where the
// published frame cut things at its edge, the drawing is finished off: the ground
// shadow's cut end gets a ragged rounded tail like its other end, and an arm reaching
// the old frame edge (7th to 10th frames) gets a rounded, outlined paw tip. Palette, knobs, acid
// noise, aberration and kaleidoscope are the original's, with the aberration direction
// and mirror axis turned with the picture.
//
// ----- original notes -----
// Ported from mesto_elephant_walk.js (browser Pattern Lab preview) to the
// ESP32-S3 firmware. Not a procedural formula: the walk cycle is 13
// hand-drawn frames baked at build time (RLE-packed, see FRAME*_RLE below),
// same idea as the JS ASCII-grid sprite. On top of the sprite:
//
//  - Concentric "breathing" rings converge INTO the elephant, shaped like
//    one reference silhouette (frame 0) scaled toward its own centroid —
//    not a distance field, which read as jagged at concave spots (between
//    the legs/ears). OWN_SCALE below holds that scaled-silhouette field.
//  - Ring closing speed is tied to the walk cycle's own frame position
//    (frames 3-8 1-indexed = "inhale", speeds up; frames 9..3 wrapping =
//    "exhale", slows back down) — not an independent clock.
//  - Knob A: hue-rotates the whole palette together.
//  - Knob B: multiplies the rings' closing speed.
//  - Knob C: one "how much madness" dial — acid noise (lets the ring-blend
//    math overshoot its normal 0..1 range, which wraps through uint8 for a
//    glitch) -> chromatic aberration -> 6-way kaleidoscope, overlapping so
//    it builds smoothly rather than switching.
//  - Knob D: spins the aberration direction and the kaleidoscope's mirror
//    axis together.
#pragma once

#include <Arduino.h>
#include "config.h"
#include "src/core_display.h"
#include "src/core_encoders.h"
#include "src/core_canvas.h"
#include "src/core_params.h"
#include "src/core_math.h"
#include "src/core_color.h"
#include "src/core_tables.h"
#include "src/core_mem.h"

namespace PatternElephantWalk {

const char* NAME = "elephant_breath";
const char* const KNOB_LABELS[4] = {"Hue", "Speed", "Madness", "Spin"};
constexpr bool ABSOLUTE_READY = true;

constexpr int FRAME_W = 128, FRAME_H = 128;

// the frames as drawn: 128 wide x 64 tall, lying on their side
constexpr int SPR_W = 128, SPR_H = 64;
// ...and where they land turned a quarter anticlockwise: SPR_H wide, SPR_W tall,
// centred. Source (x, y) -> (SPR_X0 + y, SPR_Y0 + SPR_W - 1 - x).
constexpr int SPR_X0 = (FRAME_W - SPR_H) / 2;
constexpr int SPR_Y0 = (FRAME_H - SPR_W) / 2;

// ---- palette, as HSV (h,s,v), computed once offline from the original RGB
// palette (G=background, S=ground shadow, B=body, O=outline, P=pink) — knob
// A adds to the hue channel; PFColor::hsvToRgb turns each back into RGB.
// Codes match the FRAME*_RLE packing below: 0=G 1=S 2=B 3=O 4=P. ----
constexpr float PAL_H[5] = {0.0000f, 0.0000f, 0.6000f, 0.6410f, 0.9306f};
constexpr float PAL_S[5] = {0.0000f, 0.0000f, 0.3333f, 0.7222f, 0.2353f};
constexpr float PAL_V[5] = {0.4706f, 0.3294f, 0.8824f, 0.3529f, 1.0000f};

// ---- 13 walk-cycle frames, RLE-packed (1 byte/run: top 3 bits = palette
// code above, bottom 5 bits = run length-1, runs longer than 32 split into
// several entries) — decoded sequentially in draw(), 128x64 per frame, as drawn (on its side). ----

static const uint8_t FRAME0_RLE[] = {
    14,40,31,31,31,7,12,42,31,31,31,7,12,42,31,31,31,7,12,42,26,32,96,33,
    31,31,8,12,42,25,33,100,33,31,31,4,12,42,25,96,1,97,32,101,33,31,31,12,
    42,25,96,32,98,71,32,97,33,31,27,12,42,25,97,32,96,32,73,32,64,33,31,26,
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    98,3,96,32,17,11,32,31,31,26,99,19,31,31,31,9,33,19,21,32,31,31,31,8,
};

static const uint8_t FRAME1_RLE[] = {
    15,36,0,33,31,31,31,7,14,37,0,34,31,31,31,6,14,37,0,34,31,31,31,6,
    14,37,1,33,25,97,33,31,31,8,14,37,1,33,25,101,34,31,31,3,14,37,1,33,
    25,32,97,33,102,32,31,31,14,38,0,33,24,32,99,71,32,99,32,31,26,14,38,0,
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    31,31,7,99,19,31,31,31,9,33,19,31,31,31,31,
};

static const uint8_t FRAME2_RLE[] = {
    17,33,31,31,31,11,15,35,31,31,31,11,15,35,31,31,31,11,13,37,31,31,31,11,
    12,38,25,32,6,67,31,31,5,12,38,24,32,4,32,96,33,68,31,31,3,12,38,23,
    33,3,96,0,32,97,32,101,33,31,31,12,38,23,33,2,32,97,33,96,66,35,98,32,
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    7,33,21,31,31,31,31,
};

static const uint8_t FRAME3_RLE[] = {
    11,32,6,34,31,31,31,8,17,37,31,31,31,7,16,39,31,31,31,6,15,42,22,32,
    31,31,12,15,42,21,32,97,32,31,31,10,14,43,21,32,98,32,31,31,9,13,43,22,
    35,96,33,101,33,31,31,12,44,22,33,99,66,35,98,32,31,29,12,44,22,97,33,96,
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    31,3,32,99,32,21,31,31,31,5,33,23,13,32,31,31,31,16,
};

static const uint8_t FRAME4_RLE[] = {
    15,34,31,31,31,12,14,36,31,31,31,11,13,37,25,32,31,31,16,12,40,28,97,33,
    31,31,8,12,40,28,101,33,31,31,4,12,41,27,32,98,33,100,33,31,31,12,41,26,
    32,100,32,69,32,100,32,31,25,12,41,26,33,98,32,72,32,64,32,98,31,24,12,41,
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    20,32,31,31,17,32,96,33,19,31,31,31,31,
};

static const uint8_t FRAME5_RLE[] = {
    15,32,2,34,31,31,31,8,18,35,31,31,31,8,17,36,31,31,31,8,16,38,20,32,
    4,97,33,31,31,8,16,38,19,33,3,96,32,100,33,31,31,4,15,64,38,19,33,3,
    97,32,96,33,101,33,31,31,15,64,38,24,32,98,34,71,98,32,31,27,15,64,38,24,
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    34,16,31,31,31,31,
};

static const uint8_t FRAME6_RLE[] = {
    15,37,31,0,33,31,31,6,12,40,31,0,32,99,31,31,3,12,36,0,34,31,0,33,
    99,32,31,31,1,12,36,0,34,30,97,32,96,32,0,32,1,34,31,30,12,36,0,34,
    22,32,6,98,32,97,32,3,33,31,29,12,36,0,34,21,32,6,32,102,32,0,66,34,
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    96,32,31,18,32,99,32,15,31,31,31,11,33,17,31,31,31,31,
};

static const uint8_t FRAME7_RLE[] = {
    14,37,31,2,37,31,31,1,13,40,31,32,64,96,34,65,32,31,31,13,40,30,33,64,
    97,34,64,33,31,30,13,35,0,35,29,33,66,32,96,33,66,34,31,27,13,35,0,33,
    64,32,21,32,5,33,0,32,66,96,69,33,31,27,13,35,0,35,20,32,6,37,64,96,
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    96,35,31,15,33,17,21,33,31,31,31,7,
};

static const uint8_t FRAME8_RLE[] = {
    11,128,37,31,5,100,32,96,35,31,27,11,128,36,31,5,34,97,32,97,35,31,27,11,
    128,34,31,6,36,99,32,64,33,0,33,31,24,19,32,31,0,34,97,33,98,67,34,97,
    31,22,17,32,0,32,128,22,32,8,34,98,33,96,66,32,64,34,96,32,31,21,15,34,
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    128,33,31,31,1,
};

static const uint8_t FRAME9_RLE[] = {
    9,32,4,33,31,5,37,31,31,1,9,32,4,35,31,2,96,32,96,33,96,65,32,31,
    31,9,32,4,37,31,32,102,64,33,31,30,9,32,4,37,30,96,33,96,33,98,66,34,
    31,27,15,37,22,32,6,96,34,98,32,96,67,34,31,26,15,37,21,32,6,32,97,33,
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    31,8,32,99,17,19,34,31,96,34,31,15,33,18,19,33,31,31,31,9,
};

static const uint8_t FRAME10_RLE[] = {
    11,35,31,31,31,15,11,32,5,33,31,3,35,31,31,2,17,35,31,0,33,1,34,31,
    31,1,17,36,29,97,32,0,38,31,31,31,12,32,6,99,39,31,30,31,11,32,6,32,
    100,32,96,65,35,31,29,11,36,31,0,64,97,33,100,67,34,96,32,31,26,10,37,0,
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    33,31,31,28,32,96,32,66,15,21,32,31,31,31,8,
};

static const uint8_t FRAME11_RLE[] = {
    31,31,31,31,31,31,31,31,31,31,31,31,31,16,65,32,96,33,31,31,8,31,15,66,
    101,34,31,31,3,31,14,67,33,97,33,100,33,31,31,14,38,1,34,18,67,33,97,34,
    69,32,98,32,31,27,12,40,1,34,18,67,32,99,32,72,32,96,32,64,31,26,12,40,
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    15,33,21,12,32,31,31,31,17,
};

static const uint8_t FRAME12_RLE[] = {
    13,64,36,0,34,31,31,31,7,12,65,36,0,34,31,31,31,7,11,32,65,36,0,34,
    31,31,31,7,10,128,32,64,0,40,26,32,96,33,31,31,8,10,128,33,0,39,128,25,
    32,101,33,31,31,4,10,128,33,0,39,128,25,107,33,31,31,10,128,33,0,39,128,24,
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    31,31,
};

static const uint8_t* const FRAME_RLE[13] = {
    FRAME0_RLE, FRAME1_RLE, FRAME2_RLE, FRAME3_RLE, FRAME4_RLE, FRAME5_RLE,
    FRAME6_RLE, FRAME7_RLE, FRAME8_RLE, FRAME9_RLE, FRAME10_RLE, FRAME11_RLE, FRAME12_RLE,
};
static const uint16_t FRAME_RLE_LEN[13] = {
    sizeof(FRAME0_RLE), sizeof(FRAME1_RLE), sizeof(FRAME2_RLE), sizeof(FRAME3_RLE),
    sizeof(FRAME4_RLE), sizeof(FRAME5_RLE), sizeof(FRAME6_RLE), sizeof(FRAME7_RLE),
    sizeof(FRAME8_RLE), sizeof(FRAME9_RLE), sizeof(FRAME10_RLE), sizeof(FRAME11_RLE), sizeof(FRAME12_RLE),
};

// ---- ring shape field: how many "silhouette radii" each pixel sits out
// from frame 0's centroid, along the ray from the centroid through it —
// fixed-point, value*32. A ring at scale S is "at" every pixel whose entry
// here equals S*32. The original baked this for its 128 x 64 frame; here it
// is worked out in setup() for the turned 128 x 128 one (max ~3.7 radii, in
// the corners). The silhouette's radius along each ray is its outermost
// pixel, so concave spots between legs and ears stay smooth. ----
static uint8_t OWN_SCALE[FRAME_W * FRAME_H];
static bool ownScaleReady = false;
constexpr int RAY_COUNT = 2880;
constexpr float RAY_STEP = 0.25f;
// out past 1.6 radii the outline eases into a smoothed copy of itself
constexpr float FAR_SMOOTH_FROM = 1.6f, FAR_SMOOTH_SPAN = 1.0f, FAR_SMOOTH_DEG = 6.0f;

constexpr float FRAME_DURATION = 0.08f; // seconds/frame, matches the source GIF's 12.5fps

// rings 0.35 apart as in the original (4 between 1.0 and 2.4); nine of them
// reach 4.15, past the corners' ~3.73, so the whole square is always ringed
constexpr int RING_COUNT = 9;
constexpr float RING_SCALE_MIN = 1.0f;
constexpr float RING_SCALE_MAX = RING_SCALE_MIN + 0.35f * RING_COUNT;
constexpr float RING_BASE_SPEED = 0.35f; // scale units/sec at breath-rate=1, knob B=1
constexpr float RING_HUE_SPREAD = 0.24f; // +/- ~43 degrees around the body's current hue

constexpr int INHALE_START = 2, INHALE_END = 7; // 0-indexed; 1-indexed "3rd..8th" frame
constexpr float BREATH_RATE_MIN = 0.25f, BREATH_RATE_MAX = 1.75f;

// knob C (0..4.9): one "how much madness" dial, effects overlap as it rises
constexpr float NOISE_C_LO = 0.0f, NOISE_C_HI = 2.0f, NOISE_OVERSHOOT_MAX = 5.0f;
constexpr float ABERR_C_LO = 1.0f, ABERR_C_HI = 3.5f, ABERR_MAX_PX = 6.0f;
constexpr float KALEIDO_C_LO = 2.5f, KALEIDO_C_HI = 4.9f;
constexpr int KALEIDO_SEGMENTS = 6;

// knob D's angle is measured in the original's frame; the picture is turned
// a quarter anticlockwise, so its directions are too
constexpr float TURN = -HALF_PI;

// calibrated encoder steps — carried over from the browser previewer's
// device-mode emulation (pattern_preview.html KNOBS[].devStep), not from a
// real Pattern Lab listing (none exists for this pattern yet)
constexpr float ELE_HUE_STEP = 0.05f;
constexpr float ELE_SPEED_STEP = 9.9f / 48.0f;
constexpr float ELE_MADNESS_STEP = 4.9f / 48.0f;
constexpr float ELE_SPIN_STEP = 0.05f;

// ground shadow: the published frame cut it at its edge (our x = SPR_X0);
// it gets a rounded tail this long, ragged like its other end
constexpr int SHADOW_TOP = 96;     // rows from here down are ground, not body
constexpr float SHADOW_TAIL = 6.5f;

struct Ring { float scale; float hue; };
static Ring rings[RING_COUNT];
static float hue = 0.0f;        // knob A (0..1, wraps)
static float speedCoeff = 3.0f; // knob B (0.1..10)
static float madness = 0.0f;    // knob C (0..4.9)
static float spin = 0.0f;       // knob D (0..1, wraps)
static float timeAcc = 0.0f;
static float breathRateByFrame[13];

static uint8_t codes[FRAME_W * FRAME_H]; // this frame's palette codes, turned
static float* bufA = nullptr; // FRAME_W*FRAME_H*3 floats
static float* bufB = nullptr;

static inline int elClampInt(int v, int lo, int hi) { return v < lo ? lo : (v > hi ? hi : v); }

static inline float rampC(float c, float lo, float hi) {
    if (hi <= lo) return c >= hi ? 1.0f : 0.0f;
    return PFMath::clamp01((c - lo) / (hi - lo));
}

static float randomKindredHue() {
    float offset = ((float)random(0, 10001) / 10000.0f - 0.5f) * RING_HUE_SPREAD;
    return PFMath::fract(PAL_H[2] + hue + offset);
}

static inline uint32_t elHash(uint32_t a, uint32_t b) {
    uint32_t h = a * 0x9E3779B1u ^ (b + 0x7F4A7C15u) * 0x85EBCA77u;
    h ^= h >> 15; h *= 0x2C1B3C6Du; h ^= h >> 12;
    return h;
}

// decode one RLE frame, turned, into codes[] (everything off the sprite is G)
static void decodeTurned(int frameIdx) {
    memset(codes, 0, sizeof(codes));
    const uint8_t* rle = FRAME_RLE[frameIdx];
    const uint16_t rleLen = FRAME_RLE_LEN[frameIdx];
    int x = 0, y = 0;
    for (uint16_t p = 0; p < rleLen && y < SPR_H; p++) {
        const uint8_t sym = rle[p] >> 5;
        int run = (rle[p] & 0x1F) + 1;
        while (run-- > 0 && y < SPR_H) {
            codes[(SPR_Y0 + SPR_W - 1 - x) * FRAME_W + SPR_X0 + y] = sym;
            if (++x == SPR_W) { x = 0; y++; }
        }
    }
}

// Finish what the published frame's edge cut off. Body runs touching a side
// edge (an arm swung out) get a rounded paw tip: outlined, up to three
// columns deep. The ground shadow's cut end gets a rounded, ragged tail.
static void finishEdges(int frameIdx) {
    for (int side = 0; side < 2; side++) {
        const int edgeX = side == 0 ? SPR_X0 : SPR_X0 + SPR_H - 1;
        const int dir = side == 0 ? -1 : 1;
        int y = SPR_Y0;
        while (y < SHADOW_TOP) {
            if (codes[y * FRAME_W + edgeX] == 0) { y++; continue; }
            int a = y;
            while (y < SHADOW_TOP && codes[y * FRAME_W + edgeX] != 0) y++;
            const int b = y - 1, len = b - a + 1;
            if (len < 2) continue;
            const int depth = 1 + (len >= 5) + (len >= 9);
            for (int j = 0; j < depth; j++) {
                const int cx = edgeX + dir * (j + 1);
                for (int r = a + j; r <= b - j; r++) {
                    const bool rim = (j == depth - 1) || r == a + j || r == b - j;
                    codes[r * FRAME_W + cx] = rim ? 3 : codes[r * FRAME_W + edgeX];
                }
            }
        }
    }

    // ground shadow tail, off the old frame edge at SPR_X0
    int y = SHADOW_TOP;
    const int H = SPR_Y0 + SPR_W;
    while (y < H) {
        if (codes[y * FRAME_W + SPR_X0] != 1) { y++; continue; }
        int a = y;
        while (y < H && codes[y * FRAME_W + SPR_X0] == 1) y++;
        const int b = y - 1;
        if (b - a < 1) continue;
        const float mid = 0.5f * (a + b);
        const float half = 0.5f * (b - a) + 1.0f;
        for (int r = a; r <= b; r++) {
            const float u = (r - mid) / half;
            const uint32_t h = elHash((uint32_t)r, (uint32_t)frameIdx);
            int len = (int)(SHADOW_TAIL * sqrtf(1.0f - u * u) + 0.5f) + (int)(h % 3u) - 1;
            const bool gap = (h >> 8) % 3u == 0; // a stray speck past a gap, like the other end
            for (int k = 1; k <= len; k++) {
                if (gap && k == len - 1) continue;
                codes[r * FRAME_W + SPR_X0 - k] = 1;
            }
        }
    }
}

// OWN_SCALE for the turned square, from frame 0's silhouette (B, O, P)
static void buildOwnScale() {
    if (ownScaleReady) return;
    static uint8_t sil[SPR_W * SPR_H];
    {
        const uint8_t* rle = FRAME_RLE[0];
        int i = 0;
        for (uint16_t p = 0; p < FRAME_RLE_LEN[0] && i < SPR_W * SPR_H; p++) {
            const uint8_t sym = rle[p] >> 5;
            for (int run = (rle[p] & 0x1F) + 1; run > 0 && i < SPR_W * SPR_H; run--) sil[i++] = sym >= 2;
        }
        while (i < SPR_W * SPR_H) sil[i++] = 0;
    }
    float sx = 0.0f, sy = 0.0f; int n = 0;
    for (int y = 0; y < SPR_H; y++)
        for (int x = 0; x < SPR_W; x++)
            if (sil[y * SPR_W + x]) { sx += x; sy += y; n++; }
    const float cx = n ? sx / n : SPR_W * 0.5f, cy = n ? sy / n : SPR_H * 0.5f;

    // silhouette radius along each ray: its outermost pixel
    static float rayR[RAY_COUNT];
    for (int i = 0; i < RAY_COUNT; i++) {
        const float ang = -PI + TWO_PI * (float)i / (float)RAY_COUNT;
        const float ca = cosf(ang), sa = sinf(ang);
        float best = 1.0f;
        for (float t = 0.0f; t < 150.0f; t += RAY_STEP) {
            const int px = (int)floorf(cx + ca * t + 0.5f), py = (int)floorf(cy + sa * t + 0.5f);
            if (px < 0 || px >= SPR_W || py < 0 || py >= SPR_H) continue;
            if (sil[py * SPR_W + px]) best = t;
        }
        rayR[i] = best;
    }

    // ...and the same radii smoothed over angle, for the far field: a 1 px
    // notch in the outline (a toe, a gap under an arm) would otherwise fan
    // out into a 3-4 px sawtooth by the corners
    static float raySmooth[RAY_COUNT];
    {
        const float sig = FAR_SMOOTH_DEG / 360.0f * RAY_COUNT;
        const int reach = (int)(4.0f * sig);
        float wsum = 0.0f;
        for (int k = -reach; k <= reach; k++) wsum += expf(-0.5f * (k / sig) * (k / sig));
        for (int i = 0; i < RAY_COUNT; i++) {
            float acc = 0.0f;
            for (int k = -reach; k <= reach; k++)
                acc += expf(-0.5f * (k / sig) * (k / sig)) * rayR[((i + k) % RAY_COUNT + RAY_COUNT) % RAY_COUNT];
            raySmooth[i] = acc / wsum;
        }
    }

    // every square pixel, in the original's (unturned, extended) coordinates
    for (int Y = 0; Y < FRAME_H; Y++) {
        for (int X = 0; X < FRAME_W; X++) {
            const float ox = (float)(SPR_W - 1 - (Y - SPR_Y0)), oy = (float)(X - SPR_X0);
            const float dx = ox - cx, dy = oy - cy;
            const float d = sqrtf(dx * dx + dy * dy);
            const float u = (atan2f(dy, dx) + PI) / TWO_PI * RAY_COUNT;
            int i0 = (int)floorf(u);
            const float f = u - i0;
            i0 = ((i0 % RAY_COUNT) + RAY_COUNT) % RAY_COUNT;
            const int i1 = (i0 + 1) % RAY_COUNT;
            const float near = d / (rayR[i0] + (rayR[i1] - rayR[i0]) * f);
            const float far = d / (raySmooth[i0] + (raySmooth[i1] - raySmooth[i0]) * f);
            float w = (near - FAR_SMOOTH_FROM) / FAR_SMOOTH_SPAN;
            w = w < 0.0f ? 0.0f : (w > 1.0f ? 1.0f : w);
            w = w * w * (3.0f - 2.0f * w);
            const float v = (near + (far - near) * w) * 32.0f + 0.5f;
            OWN_SCALE[Y * FRAME_W + X] = (uint8_t)(v > 255.0f ? 255.0f : v);
        }
    }
    ownScaleReady = true;
}

void setup() {
    hue = 0.0f; speedCoeff = 3.0f; madness = 0.0f; spin = 0.0f; timeAcc = 0.0f;

    // breathing rate ramp: inhale frames (INHALE_START..INHALE_END) go
    // MIN->MAX, exhale frames (wrapping around the end of the 13-frame
    // cycle) go back MAX->MIN
    {
        const float inhaleLen = (float)(INHALE_END - INHALE_START);
        for (int i = INHALE_START; i <= INHALE_END; i++) {
            float t = (float)(i - INHALE_START) / inhaleLen;
            breathRateByFrame[i] = BREATH_RATE_MIN + (BREATH_RATE_MAX - BREATH_RATE_MIN) * t;
        }
        int exhaleFrames[7];
        int ec = 0;
        for (int i = INHALE_END + 1; i < 13; i++) exhaleFrames[ec++] = i;
        for (int i = 0; i < INHALE_START; i++) exhaleFrames[ec++] = i;
        for (int k = 0; k < ec; k++) {
            float t = (float)k / (float)ec;
            breathRateByFrame[exhaleFrames[k]] = BREATH_RATE_MAX - (BREATH_RATE_MAX - BREATH_RATE_MIN) * t;
        }
    }

    for (int i = 0; i < RING_COUNT; i++) {
        rings[i].scale = RING_SCALE_MIN + (RING_SCALE_MAX - RING_SCALE_MIN) * (float)(i + 1) / (float)RING_COUNT;
        rings[i].hue = randomKindredHue();
    }

    PFMath::buildSinLUT();
    PFTables::init(); // kaleidoscope folds around the fixed panel center
    buildOwnScale();

    if (!bufA) bufA = PFMem::allocFloats(FRAME_W * FRAME_H * 3);
    if (!bufB) bufB = PFMem::allocFloats(FRAME_W * FRAME_H * 3);
}

void update(float dt, const InputFrame& input) {
    if (!bufA || !bufB) return;

    PFParams::applyUnit(input, 0, &hue, ELE_HUE_STEP);
    PFParams::apply(input, 1, &speedCoeff, 0.1f, 10.0f, ELE_SPEED_STEP);
    PFParams::apply(input, 2, &madness, 0.0f, 4.9f, ELE_MADNESS_STEP);
    PFParams::applyUnit(input, 3, &spin, ELE_SPIN_STEP);

    timeAcc += dt;
    // timeAcc only ever feeds an integer frame index (timeAcc / FRAME_DURATION),
    // never sin/cos — wrap it at the walk cycle's own period so it never
    // grows unbounded over days of runtime.
    const float cycleLen = FRAME_DURATION * 13.0f;
    if (timeAcc > cycleLen) timeAcc -= cycleLen;

    int frameIdx = (int)(timeAcc / FRAME_DURATION);
    if (frameIdx > 12) frameIdx = 12;
    const float rate = breathRateByFrame[frameIdx];
    const float step = RING_BASE_SPEED * rate * speedCoeff * dt;
    for (int i = 0; i < RING_COUNT; i++) {
        rings[i].scale -= step;
        if (rings[i].scale <= RING_SCALE_MIN) {
            rings[i].scale += (RING_SCALE_MAX - RING_SCALE_MIN);
            rings[i].hue = randomKindredHue();
        }
    }
}

void draw() {
    if (!bufA || !bufB) { PFCanvas::present(); return; }

    int frameIdx = (int)(timeAcc / FRAME_DURATION);
    frameIdx = elClampInt(frameIdx, 0, 12);

    uint8_t palR[5], palG[5], palB[5];
    for (int k = 0; k < 5; k++) {
        float h = PFMath::fract(PAL_H[k] + hue);
        PFColor::hsvToRgb(h, PAL_S[k], PAL_V[k], palR[k], palG[k], palB[k]);
    }
    uint8_t ringR[RING_COUNT], ringG[RING_COUNT], ringB[RING_COUNT];
    for (int i = 0; i < RING_COUNT; i++) {
        PFColor::hsvToRgb(rings[i].hue, PAL_S[2], PAL_V[2], ringR[i], ringG[i], ringB[i]);
    }

    // ring indices by ascending scale — insertion sort, a handful of elements
    int order[RING_COUNT];
    for (int i = 0; i < RING_COUNT; i++) order[i] = i;
    for (int i = 1; i < RING_COUNT; i++) {
        int key = order[i];
        float keyScale = rings[key].scale;
        int j = i - 1;
        while (j >= 0 && rings[order[j]].scale > keyScale) { order[j + 1] = order[j]; j--; }
        order[j + 1] = key;
    }

    const float noiseAmt = rampC(madness, NOISE_C_LO, NOISE_C_HI);
    const float aberrAmt = rampC(madness, ABERR_C_LO, ABERR_C_HI);
    const float kaleidoAmt = rampC(madness, KALEIDO_C_LO, KALEIDO_C_HI);
    const float overshoot = noiseAmt * NOISE_OVERSHOOT_MAX;
    const float spinAngle = spin * TWO_PI + TURN;

    // ---- pass 1: elephant + rings into bufA (a plain buffer, not the
    // display — later passes need to re-sample already-drawn pixels, which
    // PFCanvas::setPixel can't give back) ----
    decodeTurned(frameIdx);
    finishEdges(frameIdx);

    for (int y = 0; y < FRAME_H; y++) {
        for (int x = 0; x < FRAME_W; x++) {
            const uint8_t code = codes[y * FRAME_W + x];
            const int idx = (y * FRAME_W + x) * 3;

            if (code == 2 || code == 3 || code == 4) { // B, O, P: the elephant itself
                bufA[idx] = palR[code]; bufA[idx + 1] = palG[code]; bufA[idx + 2] = palB[code];
                continue;
            }

            // background/shadow: blend toward whichever ring bounds this
            // point's own-scale from outside, fading to the reference
            // silhouette's edge (or the next ring in)
            const uint8_t ownScaleFixed = OWN_SCALE[y * FRAME_W + x];
            const float ownScale = ownScaleFixed / 32.0f;

            int outerPos = -1;
            for (int p = 0; p < RING_COUNT; p++) {
                if (rings[order[p]].scale >= ownScale) { outerPos = p; break; }
            }
            if (outerPos == -1) {
                bufA[idx] = palR[code]; bufA[idx + 1] = palG[code]; bufA[idx + 2] = palB[code];
                continue;
            }

            const int outerIdx = order[outerPos];
            const float outerS = rings[outerIdx].scale;
            const float innerS = outerPos > 0 ? rings[order[outerPos - 1]].scale : RING_SCALE_MIN;
            float t = outerS > innerS ? (outerS - ownScale) / (outerS - innerS) : 0.0f;
            // acid noise: let t run past its normal 0..1 range — harmless
            // at overshoot=0, increasingly deranged as knob C opens it up
            // (int-then-uint8_t cast at the end wraps it, on purpose)
            if (t < -overshoot) t = -overshoot; else if (t > 1.0f + overshoot) t = 1.0f + overshoot;

            bufA[idx]     = ringR[outerIdx] * (1.0f - t) + palR[code] * t;
            bufA[idx + 1] = ringG[outerIdx] * (1.0f - t) + palG[code] * t;
            bufA[idx + 2] = ringB[outerIdx] * (1.0f - t) + palB[code] * t;
        }
    }

    float* src = bufA;

    // ---- pass 2: chromatic aberration — R/B sampled shifted apart along
    // knob D's angle, G stays put ----
    if (aberrAmt > 0.0f) {
        const float shift = aberrAmt * ABERR_MAX_PX;
        const float dx = PFMath::fastCos(spinAngle) * shift;
        const float dy = PFMath::fastSin(spinAngle) * shift;
        for (int y = 0; y < FRAME_H; y++) {
            for (int x = 0; x < FRAME_W; x++) {
                const int idx = (y * FRAME_W + x) * 3;
                const int rx = elClampInt((int)(x - dx + 0.5f), 0, FRAME_W - 1);
                const int ry = elClampInt((int)(y - dy + 0.5f), 0, FRAME_H - 1);
                const int bx = elClampInt((int)(x + dx + 0.5f), 0, FRAME_W - 1);
                const int by = elClampInt((int)(y + dy + 0.5f), 0, FRAME_H - 1);
                bufB[idx]     = src[(ry * FRAME_W + rx) * 3];
                bufB[idx + 1] = src[idx + 1];
                bufB[idx + 2] = src[(by * FRAME_W + bx) * 3 + 2];
            }
        }
        src = bufB;
    }

    // ---- pass 3: kaleidoscope — folds around the FIXED panel center, so
    // this uses PFTables::rT/thetaT instead of per-pixel sqrtf/atan2f ----
    float* kOut = (src == bufA) ? bufB : bufA;
    if (kaleidoAmt > 0.0f) {
        const float wedge = TWO_PI / (float)KALEIDO_SEGMENTS;
        for (int y = 0; y < FRAME_H; y++) {
            for (int x = 0; x < FRAME_W; x++) {
                const int idx = (y * FRAME_W + x) * 3;
                const int ti = y * PANEL_RES_W + x;
                const float radius = PFTables::rT[ti] * (float)PANEL_RES_H;
                const float baseAngle = PFTables::thetaT[ti] - spinAngle;
                float angle = PFMath::jsMod(PFMath::jsMod(baseAngle, wedge) + wedge, wedge);
                if (((int)PFMath::floorF(baseAngle / wedge)) % 2 != 0) angle = wedge - angle;
                const float finalAngle = angle + spinAngle;
                const int sx = elClampInt((int)(FRAME_W * 0.5f + PFMath::fastCos(finalAngle) * radius + 0.5f), 0, FRAME_W - 1);
                const int sy = elClampInt((int)(FRAME_H * 0.5f + PFMath::fastSin(finalAngle) * radius + 0.5f), 0, FRAME_H - 1);
                const int sidx = (sy * FRAME_W + sx) * 3;
                kOut[idx]     = src[idx]     * (1.0f - kaleidoAmt) + src[sidx]     * kaleidoAmt;
                kOut[idx + 1] = src[idx + 1] * (1.0f - kaleidoAmt) + src[sidx + 1] * kaleidoAmt;
                kOut[idx + 2] = src[idx + 2] * (1.0f - kaleidoAmt) + src[sidx + 2] * kaleidoAmt;
            }
        }
        src = kOut;
    }

    for (int y = 0; y < FRAME_H; y++) {
        for (int x = 0; x < FRAME_W; x++) {
            const int idx = (y * FRAME_W + x) * 3;
            const int ri = (int)(src[idx] + 0.5f);
            const int gi = (int)(src[idx + 1] + 0.5f);
            const int bi = (int)(src[idx + 2] + 0.5f);
            PFCanvas::setPixel(x, y, (uint8_t)ri, (uint8_t)gi, (uint8_t)bi);
        }
    }
    PFCanvas::present();
}

} // namespace PatternElephantWalk
