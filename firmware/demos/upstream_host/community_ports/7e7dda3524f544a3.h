// ===== Patternflow pattern =====
// Title:    Animated Ocular Vortex Blinking Gaze Pupil RGB Remix
// Author:   @martinnlopez (ported by @engmung)
// Source:   https://community.patternflow.work/community/p/7e7dda3524f544a3
// SPDX-License-Identifier: CC-BY-SA-4.0
// ===============================
// Adapted for Patternflood's 128 x 128 panel (2026-10-30): the same face, with a forehead and
// a chin. The eyes keep the original's 128 x 64 geometry, in a band from row 20; the skin
// fills the square around them. The drawing is split at its empty rows: the brows stay over
// the eyes, and the nose drops 20 rows, so its bridge starts between the eyes and its tip
// falls below them (in the 64-row original it sat level with them). Grown as written, the
// drawing filled only the top half and the eyes stretched to the full height.
// Pattern: Layer Stack — Pattern Lab layer-stack composition (2 layers)
//
// SCAFFOLD (deterministic, generated by Pattern Lab — do not hand-edit):
// buffers, shared-knob accumulation, ramp LUTs, pixel art, masks, blending
// and compositing are finished code. ONLY the "namespace L<i>" blocks between
// the >>> markers are translated from each layer's JavaScript; stubs compile
// to a black layer until replaced.
//
// Layers (bottom → top):
//   L0. Animated Ocular Vortex Blinking Gaze Pupil RGB Remix (code, normal, 100%)
//   L1. face (pixel, normal, 100%)
#pragma once
#include <Arduino.h>
#include "config.h"
#include "src/core_display.h"
#include "src/core_encoders.h"
#include "src/core_canvas.h"
#include "src/core_mem.h"
#include "src/core_math.h"
#include "src/core_color.h"
#include "src/core_noise.h"
#include "src/core_tables.h"

namespace LabStack_Layer_Stack {

const char* NAME = "Layer Stack";
const char* const KNOB_LABELS[4] = {"Glitch", "Speed", "Freq", "Quantize"};

constexpr int FRAME_W = 128;
constexpr int FRAME_H = 128;
constexpr int PIX_N = FRAME_W * FRAME_H;
constexpr int FACE_H = 64;                 // the original's frame: the eyes' geometry and the drawing
constexpr int FACE_TOP = 20;              // the face's first row in the square
constexpr int BROW_ROWS = 21;              // the drawing's brows, above its empty rows 19-23
constexpr int NOSE_DROP = 20;             // how far below its drawn place the nose goes
constexpr int LAYER_N = 2;

// ── Shared knobs: encoder detents become values HERE, once, for every layer ──
static const float KNOB_MIN[4]  = {0.0f, 0.05f, 10.0f, 0.5f};
static const float KNOB_MAX[4]  = {1.0f, 3.0f, 120.0f, 2.5f};
static const float KNOB_STEP[4] = {0.02083f, 0.06146f, 2.29167f, 0.04167f}; // value per detent — two turns cross the range
static float knobVal[4]  = {0.62f, 0.971f, 51.816f, 2.5f};
static float knobNorm[4] = {0.62f, 0.3122f, 0.38015f, 1.0f};

// ── Layer buffers (RGBA8, PSRAM-first, allocated once in setup) ──
static uint8_t* layerBuf[LAYER_N] = {nullptr, nullptr};

// ── Composite plan (bottom → top; blend: 0 normal, 1 add, 2 multiply, 3 screen) ──
constexpr int GROUP_N = 2;
static const uint8_t G_LAYER[2]   = {0, 1};
static const float   G_OPACITY[2] = {1.0f, 1.0f};
static const uint8_t G_BLEND[2]   = {0, 0};
static const uint8_t G_MASK_AT[2] = {0, 0};
static const uint8_t G_MASK_N[2]  = {0, 0};
static const uint8_t MASK_LAYER[1]  = {0};
static const uint8_t MASK_PXART[1]  = {0};
static const uint8_t MASK_INVERT[1] = {0};

// ── L0 "Animated Ocular Vortex Blinking Gaze Pupil RGB Remix": ramp LUT (RGBA, alpha included — baked by Pattern Lab, copy-proof) ──
static const uint8_t L0_RAMP[256][4] = {
  {0,0,0,255},{1,1,1,255},{2,2,2,255},{3,3,3,255},{4,4,4,255},{5,5,5,255},{6,6,6,255},{7,7,7,255},
  {8,8,8,255},{9,9,9,255},{10,10,10,255},{11,11,11,255},{12,12,12,255},{13,13,13,255},{14,14,14,255},{15,15,15,255},
  {16,16,16,255},{17,17,17,255},{18,18,18,255},{19,19,19,255},{20,20,20,255},{21,21,21,255},{22,22,22,255},{23,23,23,255},
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  {248,248,248,255},{249,249,249,255},{250,250,250,255},{251,251,251,255},{252,252,252,255},{253,253,253,255},{254,254,254,255},{255,255,255,255}
};
static inline void L0_setValue(int x, int y, float v) {
  if ((unsigned)x >= (unsigned)FRAME_W || (unsigned)y >= (unsigned)FRAME_H) return;
  if (!(v > 0.0f)) v = 0.0f; else if (v > 1.0f) v = 1.0f;
  const uint8_t* c = L0_RAMP[(int)(v * 255.0f + 0.5f)];
  uint8_t* p = layerBuf[0] + (((size_t)y * FRAME_W + x) << 2);
  p[0] = c[0]; p[1] = c[1]; p[2] = c[2]; p[3] = c[3];
}
static inline void L0_setPixel(int x, int y, uint8_t r, uint8_t g, uint8_t b) {
  if ((unsigned)x >= (unsigned)FRAME_W || (unsigned)y >= (unsigned)FRAME_H) return;
  uint8_t* p = layerBuf[0] + (((size_t)y * FRAME_W + x) << 2);
  p[0] = r; p[1] = g; p[2] = b; p[3] = 255;
}

// ── L1 "face": pixel art, RLE {count,r,g,b,a} — decoded once in setup ──
static const uint8_t L1_RLE[5280] = {
  255,0,0,0,0,255,0,0,0,0,255,0,0,0,0,146,0,0,0,0,
  1,90,75,75,17,1,90,78,76,143,14,32,16,16,143,1,51,39,39,143,
  1,194,194,194,143,1,191,191,191,8,59,0,0,0,0,1,63,31,31,8,
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  5,219,169,129,255,255,0,0,0,0,255,0,0,0,0,54,0,0,0,0
};

// >>> LAYER 0 TRANSLATION BEGIN <<<
namespace L0 {
  static float timeAcc = 0.0f;

  void setup() {
    timeAcc = 0.0f;
    PFMath::buildSinLUT();
  }

  void update(float dt, const InputFrame& input) {
    float speed = knobNorm[1] * 3.0f;
    float effectiveSpeed = (speed > 0.0f) ? speed : 1.0f;
    timeAcc += dt * effectiveSpeed;
    if (timeAcc > 1814.4f) {
      timeAcc = fmodf(timeAcc, 1814.4f);
    }
  }

  void draw() {
    float t = timeAcc;
    int w = FRAME_W;
    int h = FACE_H;
    bool isVertical = (h > w);
    float folds = 6.0f;

    float k1 = knobNorm[0];
    float k3 = knobNorm[2];
    float k4 = knobNorm[3];

    float eyeSpacing = isVertical ? (float)h * 0.28f : (float)w * 0.28f;
    float cx1 = isVertical ? (float)w * 0.5f : (float)w * 0.5f - eyeSpacing;
    float cy1 = isVertical ? (float)h * 0.5f - eyeSpacing : (float)h * 0.5f;

    float cx2 = isVertical ? (float)w * 0.5f : (float)w * 0.5f + eyeSpacing;
    float cy2 = isVertical ? (float)h * 0.5f + eyeSpacing : (float)h * 0.5f;

    float rx = isVertical ? (float)w * 0.34f : (float)w * 0.18f;
    float ry = isVertical ? (float)h * 0.18f : (float)h * 0.34f;
    float invRx = (rx > 0.0001f) ? (1.0f / rx) : 0.0f;

    float blinkPeriod = 3.6f;
    float blinkProgress = fmodf(t, blinkPeriod);
    if (blinkProgress < 0.0f) blinkProgress += blinkPeriod;
    float blinkFactor = 0.0f;
    if (blinkProgress < 0.24f) {
      blinkFactor = PFMath::fastSin((blinkProgress / 0.24f) * PI);
    }
    float currentRy = ry * (1.0f - blinkFactor * 0.94f);
    if (currentRy < 0.8f) currentRy = 0.8f;

    float gazeRangeX = rx * 0.42f * (0.2f + k4 * 0.8f);
    float gazeRangeY = ry * 0.32f * (0.2f + k4 * 0.8f);

    float lookX = PFMath::fastSin(t * 0.8f) * 0.65f + PFMath::fastSin(t * 1.5f) * 0.35f;
    float lookY = PFMath::fastCos(t * 0.55f) * 0.70f + PFMath::fastSin(t * 1.2f) * 0.30f;

    float gazeX = lookX * gazeRangeX;
    float gazeY = lookY * gazeRangeY;

    float dimBase = isVertical ? (float)h : (float)w;
    float irisR = dimBase * (0.08f + k4 * 0.05f);
    float pupilR = irisR * 0.48f;

    float sectorAngle = TWO_PI / folds;
    float invSectorAngle = 1.0f / sectorAngle;
    float twistDepth = k4 * 0.18f;
    float baseHue = k1;
    float rgbAmount = k3;

    uint8_t outlineR = 0, outlineG = 0, outlineB = 0;
    float outlineHue = PFMath::fract(baseHue + 0.5f);
    PFColor::hsvToRgb(outlineHue, 0.7f, 0.9f, outlineR, outlineG, outlineB);

    float halfW = (float)w * 0.5f;
    float halfH = (float)h * 0.5f;

    for (int y = 0; y < FRAME_H; y++) {
      float fy = (float)(y - FACE_TOP);
      for (int x = 0; x < w; x++) {
        float fx = (float)x;
        bool isSecondEye = isVertical ? (fy >= halfH) : (fx >= halfW);
        float cx = isSecondEye ? cx2 : cx1;
        float cy = isSecondEye ? cy2 : cy1;

        float socketDx = fx - cx;
        float socketDy = fy - cy;
        float nx = socketDx * invRx;
        float absNx = fabsf(nx);

        uint8_t r = 230, g = 185, b = 145;

        if (absNx < 1.0f) {
          float maxH = currentRy * (1.0f - nx * nx);
          float absDy = fabsf(socketDy);
          float eyeDist = (maxH > 0.05f) ? (absDy / maxH) : 2.0f;

          if (eyeDist <= 1.0f) {
            if (eyeDist >= 0.76f || currentRy < 2.5f) {
              r = outlineR;
              g = outlineG;
              b = outlineB;
            } else {
              float pupilCx = cx + gazeX;
              float pupilCy = cy + gazeY;

              float pdx = fx - pupilCx;
              float pdy = fy - pupilCy;
              float distToPupil = sqrtf(pdx * pdx + pdy * pdy);

              if (distToPupil <= irisR) {
                float mirrorPdx = isSecondEye ? -pdx : pdx;
                float gx = pupilCx - irisR * 0.12f;
                float gy = pupilCy + irisR * 0.12f;
                float gdx = fx - gx;
                float gdy = fy - gy;
                float gDist = sqrtf(gdx * gdx + gdy * gdy);
                bool isGlint = (gDist < pupilR * 0.55f) && !(fx < gx && fy > gy);

                if (distToPupil <= pupilR) {
                  if (isGlint) {
                    r = 255;
                    g = 255;
                    b = 255;
                  } else if (rgbAmount <= 0.001f) {
                    r = 5;
                    g = 5;
                    b = 15;
                  } else {
                    float pupilHue = PFMath::fract(t * 0.8f + distToPupil * 0.15f + (pdx + pdy) * 0.05f);
                    uint8_t pr = 0, pg = 0, pb = 0;
                    PFColor::hsvToRgb(pupilHue, 0.95f, 1.0f, pr, pg, pb);

                    float invRgb = 1.0f - rgbAmount;
                    r = (uint8_t)(5.0f * invRgb + (float)pr * rgbAmount);
                    g = (uint8_t)(5.0f * invRgb + (float)pg * rgbAmount);
                    b = (uint8_t)(15.0f * invRgb + (float)pb * rgbAmount);
                  }
                } else {
                  float angle = PFMath::fastAtan2(pdy, mirrorPdx) + PI;
                  float sector = fmodf(angle, sectorAngle);
                  if (sector < 0.0f) sector += sectorAngle;
                  float foldedAngle = fabsf(sector - sectorAngle * 0.5f);

                  float twistedAngle = foldedAngle + distToPupil * twistDepth - t * 0.8f;
                  float u = distToPupil * PFMath::fastCos(twistedAngle);
                  float v = distToPupil * PFMath::fastSin(twistedAngle);

                  float tileSize = 8.0f;
                  float tileX = floorf(u / tileSize);
                  float tileY = floorf(v / tileSize);
                  float localU = u - tileX * tileSize - tileSize * 0.5f;
                  float localV = v - tileY * tileSize - tileSize * 0.5f;
                  float localDist = sqrtf(localU * localU + localV * localV);

                  float wave = PFMath::fastSin(localDist * 0.65f - t * 2.0f + (tileX + tileY) * 0.5f);
                  float intensity = (wave + 1.0f) * 0.5f;
                  float pixelHue = PFMath::fract(baseHue + distToPupil * 0.012f + intensity * 0.18f);

                  if (intensity > 0.82f) {
                    r = 255;
                    g = 255;
                    b = 255;
                  } else if (intensity > 0.35f) {
                    float br = 0.5f + intensity * 0.5f;
                    PFColor::hsvToRgb(pixelHue, 0.95f, br, r, g, b);
                  } else {
                    float darkHue = PFMath::fract(pixelHue + 0.5f);
                    PFColor::hsvToRgb(darkHue, 1.0f, 0.2f, r, g, b);
                  }
                }
              } else {
                float scleraPulse = PFMath::fastSin(fx * 0.1f + fy * 0.1f + t) * 15.0f;
                int rVal = (int)(220.0f + scleraPulse);
                int gVal = (int)(235.0f + scleraPulse);
                r = (uint8_t)(rVal < 0 ? 0 : (rVal > 255 ? 255 : rVal));
                g = (uint8_t)(gVal < 0 ? 0 : (gVal > 255 ? 255 : gVal));
                b = 255;
              }
            }
          }
        }

        L0_setPixel(x, y, r, g, b);
      }
    }
  }
}
// >>> LAYER 0 TRANSLATION END <<<

// ── Deterministic pipeline (do not edit) ──
static void rleDecode(const uint8_t* rle, size_t len, uint8_t* out, size_t cap) {
  size_t o = 0;
  for (size_t i = 0; i + 4 < len && o < cap; i += 5) {
    for (int k = 0; k < rle[i] && o < cap; k++) {
      out[o++] = rle[i + 1]; out[o++] = rle[i + 2]; out[o++] = rle[i + 3]; out[o++] = rle[i + 4];
    }
  }
}

// Binary mask test — identical to the Pattern Lab preview: pixel art is "on"
// where something was drawn (alpha >= 0.5); code layers where ramp-colored
// luminance x alpha crosses 0.5.
static inline bool maskOn(const uint8_t* p, bool pixelArt, bool invert) {
  bool on;
  if (pixelArt) on = p[3] >= 128;
  else on = (0.2126f * p[0] + 0.7152f * p[1] + 0.0722f * p[2]) * (p[3] / 255.0f) >= 127.5f;
  return invert ? !on : on;
}

static void recolorBuffer(uint8_t* buf, const uint8_t lut[256][4]) {
  for (int i = 0; i < PIX_N; i++) {
    uint8_t* p = buf + (size_t)i * 4;
    if (p[3] == 0) continue;
    int lum = (int)(0.2126f * p[0] + 0.7152f * p[1] + 0.0722f * p[2] + 0.5f);
    if (lum > 255) lum = 255;
    const uint8_t* c = lut[lum];
    p[0] = c[0]; p[1] = c[1]; p[2] = c[2]; p[3] = c[3];
  }
}

void setup() {
  for (int i = 0; i < LAYER_N; i++)
    if (!layerBuf[i]) layerBuf[i] = (uint8_t*)PFMem::alloc((size_t)PIX_N * 4);
  for (int i = 0; i < LAYER_N; i++)
    if (!layerBuf[i]) return; // allocation failed → draw() degrades to blank
  // The drawing at its own size, then its rows into the square: brows with the eyes, the nose lower.
  uint8_t* art = (uint8_t*)PFMem::alloc((size_t)FRAME_W * FACE_H * 4);
  memset(layerBuf[1], 0, (size_t)PIX_N * 4);
  if (art) {
    rleDecode(L1_RLE, sizeof(L1_RLE), art, (size_t)FRAME_W * FACE_H * 4);
    for (int y = 0; y < FACE_H; y++) {
      const int to = FACE_TOP + y + (y < BROW_ROWS ? 0 : NOSE_DROP);
      if (to < FRAME_H)
        memcpy(layerBuf[1] + (size_t)to * FRAME_W * 4, art + (size_t)y * FRAME_W * 4, (size_t)FRAME_W * 4);
    }
    free(art);
  }
  L0::setup();
}

void update(float dt, const InputFrame& input) {
  for (int i = 0; i < 4; i++) {
    knobVal[i] += input.knobDeltas[i] * KNOB_STEP[i];
    if (knobVal[i] < KNOB_MIN[i]) knobVal[i] = KNOB_MIN[i];
    if (knobVal[i] > KNOB_MAX[i]) knobVal[i] = KNOB_MAX[i];
    knobNorm[i] = (knobVal[i] - KNOB_MIN[i]) / (KNOB_MAX[i] - KNOB_MIN[i]);
  }
  L0::update(dt, input);
}

void draw() {
  for (int i = 0; i < LAYER_N; i++)
    if (!layerBuf[i]) { PFCanvas::present(); return; }

  memset(layerBuf[0], 0, (size_t)PIX_N * 4);
  L0::draw();

  // Composite bottom → top over the panel's black — same math as the web preview.
  for (int y = 0; y < FRAME_H; y++) {
    for (int x = 0; x < FRAME_W; x++) {
      const size_t j = ((size_t)y * FRAME_W + x) << 2;
      float cr = 0.0f, cg = 0.0f, cb = 0.0f;
      for (int gi = 0; gi < GROUP_N; gi++) {
        bool hidden = false;
        for (int m = 0; m < G_MASK_N[gi]; m++) {
          const int mi = G_MASK_AT[gi] + m;
          if (!maskOn(layerBuf[MASK_LAYER[mi]] + j, MASK_PXART[mi] != 0, MASK_INVERT[mi] != 0)) {
            hidden = true;
            break;
          }
        }
        if (hidden) continue;
        const uint8_t* p = layerBuf[G_LAYER[gi]] + j;
        const float a = (p[3] / 255.0f) * G_OPACITY[gi];
        if (a <= 0.0f) continue;
        const float sr = p[0], sg = p[1], sb = p[2], inv = 1.0f - a;
        switch (G_BLEND[gi]) {
          case 1: cr += sr * a; cg += sg * a; cb += sb * a; break;
          case 2:
            cr = cr * inv + (cr * sr / 255.0f) * a;
            cg = cg * inv + (cg * sg / 255.0f) * a;
            cb = cb * inv + (cb * sb / 255.0f) * a;
            break;
          case 3:
            cr = cr * inv + (255.0f - (255.0f - cr) * (255.0f - sr) / 255.0f) * a;
            cg = cg * inv + (255.0f - (255.0f - cg) * (255.0f - sg) / 255.0f) * a;
            cb = cb * inv + (255.0f - (255.0f - cb) * (255.0f - sb) / 255.0f) * a;
            break;
          default:
            cr = cr * inv + sr * a;
            cg = cg * inv + sg * a;
            cb = cb * inv + sb * a;
            break;
        }
      }
      int ir = (int)(cr + 0.5f); if (ir > 255) ir = 255;
      int ig = (int)(cg + 0.5f); if (ig > 255) ig = 255;
      int ib = (int)(cb + 0.5f); if (ib > 255) ib = 255;
      PFCanvas::setPixel(x, y, (uint8_t)ir, (uint8_t)ig, (uint8_t)ib);
    }
  }
  PFCanvas::present();
}

} // namespace LabStack_Layer_Stack